#include <talkie.h> //음성출력 라이브러리
//USB 호스트 쉴드 라이브러리
#include <usbhid.h>
#include <usbhub.h>
#include <hiduniversal.h>
#include <hidboot.h>
#include <SPI.h> //USB SPI통신 이용

#include <string.h> //바코드 비교를 위한 라이브러리

Talkie voice; 
//음성데이터 16진수로 저장
const uint8_t chilsung[] PROGMEM = {0x00, 0x00, 0x40, 0x80, 0x2e, 0xc5, 0x1a, 0x55, 0x39, 0xc7, 0xb4, 0x39, 0x3e,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 0x1e, 0xff};
const uint8_t coke[] PROGMEM = {0x00, 0x08, 0x88, 0x5b, 0xdd, 0x00, 0xb1, 0x86, 0x2f, 0x4a, 0x4d, 0xb2, 0xac,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 0xe0, 0xff};
const uint8_t zero_coke[] PROGMEM = {0x00, 0x00, 0x06, 0xf3, 0x4d, 0xc3, 0x2d, 0x22, 0x19, 0x20, 0xf6, 0xf0, 0x45,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 0x80, 0xff};
const uint8_t pocari[] PROGMEM = {0x00, 0x00, 0x02, 0x08, 0x45, 0x75, 0xd1, 0xb6, 0x18, 0x47, 0xa5, 0x9d, 0x45,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 0x78, 0xff};
const uint8_t hot6[] PROGMEM = {0x00, 0x00, 0x60, 0x80, 0x16, 0x3d, 0x0e, 0x9d, 0xb4, 0x7a, 0x68, 0x34, 0x3d,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 0x80, 0xff};
const uint8_t fishsnack[] PROGMEM = {0x00, 0x00, 0x08, 0xe8, 0x42, 0x84, 0x00, 0x4d, 0xa9, 0x2b, 0x60, 0x78, 0x8a,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 0x80, 0xff};

void bar_voice();
char bar_data[50]; //바코드 값 저장할 배열
int i = 0;
void save_data(char data);
class MyParser : public HIDReportParser {
  public:
    MyParser();
    void Parse(USBHID *hid, bool is_rpt_id, uint8_t len, uint8_t *buf);
  protected:
    uint8_t KeyToAscii(bool upper, uint8_t mod, uint8_t key);
    virtual void OnKeyScanned(bool upper, uint8_t mod, uint8_t key);
    virtual void OnScanFinished();
};

MyParser::MyParser() {}

void MyParser::Parse(USBHID *hid, bool is_rpt_id, uint8_t len, uint8_t *buf) {
  // If error or empty, return
  if (buf[2] == 1 || buf[2] == 0) return;

  for (uint8_t i = 7; i >= 2; i--) {
    // If empty, skip
    if (buf[i] == 0) continue;

    // If enter signal emitted, scan finished
    if (buf[i] == UHS_HID_BOOT_KEY_ENTER) {
      OnScanFinished();
    }

    // If not, continue normally
    else {
      // If bit position not in 2, it's uppercase words
      OnKeyScanned(i > 2, buf, buf[i]);
    }

    return;
  }
}

uint8_t MyParser::KeyToAscii(bool upper, uint8_t mod, uint8_t key) {
  // Letters
  if (VALUE_WITHIN(key, 0x04, 0x1d)) {
    if (upper) return (key - 4 + 'A');
    else return (key - 4 + 'a');
  }

  // Numbers
  else if (VALUE_WITHIN(key, 0x1e, 0x27)) {
    return ((key == UHS_HID_BOOT_KEY_ZERO) ? '0' : key - 0x1e + '1');
  }

  return 0;
}

void MyParser::OnKeyScanned(bool upper, uint8_t mod, uint8_t key) {
  uint8_t ascii = KeyToAscii(upper, mod, key);
  Serial.print((char)ascii);
  char bar_code = (char)ascii;
  save_data(bar_code);
}

void MyParser::OnScanFinished() {
  bar_data[i] = '\0'; //널문자 추가
  Serial.println(" - Finished");
  bar_voice();
  i = 0;
  
}
void bar_voice() //음성출력
{
  if(strcmp(bar_data,"1234567890128")==0){ //칠성사이다
    voice.say(chilsung);
    delay(500);
    voice.say(chilsung);
  }
  else if(strcmp(bar_data,"1234567890158")==0){ //코카콜라
    voice.say(coke);
    delay(500);
    voice.say(coke);
  }
  else if(strcmp(bar_data,"8809612842280")==0){ //코카콜라 제로
    voice.say(zero_coke);
    delay(500);
    voice.say(zero_coke);
  }
  else if(strcmp(bar_data,"8801056836016")==0){ //포카리스웨트
    voice.say(pocari);
    delay(500);
    voice.say(pocari);
  }
  else if(strcmp(bar_data,"1234567890128")==0){ //핫식스
    voice.say(hot6);
    delay(500);
    voice.say(hot6);
  }
  else if(strcmp(bar_data,"8809482500013")==0){ //새우깡
    voice.say(fishsnack);
    delay(500);
    voice.say(fishsnack);
  }
}

USB          Usb;
USBHub       Hub(&Usb);
HIDUniversal Hid(&Usb);
MyParser     Parser;

void setup() {
  Serial.begin( 115200 );
  Serial.println("Start");

  if (Usb.Init() == -1) {
    Serial.println("OSC did not start.");
  }

  delay( 200 );

  Hid.SetReportParser(0, &Parser);
}
void save_data(char data) //바코드 데이터 배열형식으로 저장
{
  bar_data[i] = data;
  i++;
}

void loop() {
  Usb.Task();
}
